/*********************************************************
文件名：lcd.c
功能  ：LCD的初始化及其功能函数
作者  ：严超彬
日期  :2014/12/25
**********************************************************/
/**@supplement	8行8列*/
#include "rbc_lcd.h"
unsigned char const num_table[]={"0123456789ABCDEF"};
unsigned char const font5x8[][5]={
0x00, 0x00, 0x00, 0x00, 0x00,   // sp     
0x00, 0x00, 0x2f, 0x00, 0x00,   // !     
0x00, 0x07, 0x00, 0x07, 0x00,   // "     
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0x08, 0x10, 0x08, 0x04, 0x08    // ~ 
};


#define Up_to_Down


void LCD_GPIO_Config(void)
{
	/* BCar*/
	GPIO_Config(RBC_LCD_GPIOX, RBC_LCD_PINX, GPIO_Mode_OUT,GPIO_OType_PP, GPIO_PuPd_NOPULL);
}


void ROC_LCD_Init(void)
{
	LCD_GPIO_Config();
	RES(0);
	RES(1);
	Send_Command(0xe2); //软复位
	Send_Command(0x2c); //升压步骤1
	Send_Command(0x2e); //升压步骤2
	Send_Command(0x2f); //升压步骤3
	Send_Command(0x23); //粗调对比度，可设置范围 20～27   //0x23
	Send_Command(0x81); //微调对比度
	Send_Command(0x28); //微调对比度的值，可设置范围 0～63  //0x28
	Send_Command(0xa2); //1/9 偏压比（bias）
	#ifdef Up_to_Down/*******正显示*******/ 
		Send_Command(0xc8); //行扫描顺序：从上到下
		Send_Command(0xa0); //列扫描顺序：从左到右
	#else/*******倒显示*******/
		Send_Command(0xc0); //行扫描顺序：从下到上	
		Send_Command(0xa1); //列扫描顺序：从右到左
	#endif
	Send_Command(0xaf); //开显示
	Clear_LCD();
}


void Send_Command(unsigned char command)
{
	unsigned char i;
	CS(0);
	RS(0);
	for(i=0;i<8;i++)
	{
		SCLK(0);
		if(command&0x80)
		{
			SID(1);
		}
		else
		{
			SID(0);
		}
		SCLK(1);
		command<<=1;
	}
	CS(1);
}


void Send_data(unsigned char data)
{
	unsigned char i;
	CS(0);
	RS(1);
	for(i=0;i<8;i++)
	{
		SCLK(0);
		if(data&0x80)
		{
			SID(1);
		}
		else
		{
			SID(0);
		}
		SCLK(1);
		data<<=1;
	}
	CS(1);
}


/***********清屏函数**************/
void Clear_LCD(void)
{
	unsigned char i,j;
	for(i=0;i<8;i++)
	{
		LCD_set_XY(0,i);
		for(j=0;j<128;j++)
		{
			Send_data(0x00);
		}
	}
}


/***********设定光标坐标**************/
void LCD_set_XY(unsigned char X, unsigned char Y)
{
	X=X*6;
	Send_Command(0xb0+Y);
	#ifdef Up_to_Down /*******正显示*******/
		Send_Command(0x10+(X>>4));
		Send_Command(X&0x0f);
	#else/*******倒显示*******/		
		Send_Command(0x10+(X>>4));
		Send_Command(0x04+(X&0x0f));
	#endif
}

/***********************************************************
函数名称：LCD_write_char
函数功能：显示英文字符
入口参数：c	:  显示的字符
出口参数：无 
备 注： 
***********************************************************/
void LCD_write_char(unsigned char c)
{
   unsigned char i;
	c-=32;
   for (i=0;i<5; i++)
	{
   	Send_data(font5x8[c][i]);
	}
	Send_data(0x00);
}

/***********在指定的X,Y处显示字符串**************/
void LCD_Write_string(unsigned char *table,unsigned char X, unsigned char Y)
{
	LCD_set_XY(X,Y);	
	while(*table!=0)
	{
		LCD_write_char(*table++);
	}
}


/***********在指定的X,Y处显示整型数据**************/
void LCD_Display_int(signed int Data,unsigned char X, unsigned char Y)
{
	unsigned char Str[20];
	int2str(Data,Str);	
	LCD_Write_string(Str,X,Y);
	LCD_write_char(' ');//一般在显示完成之后再写一个空格，确保清掉上次显示遗留的数据
	LCD_write_char(' ');//一般在显示完成之后再写一个空格，确保清掉上次显示遗留的数据
}


/***********在指定的X,Y处显示浮点数据**************/
void LCD_Display_float(float Data,unsigned char X, unsigned char Y)
{
	unsigned char Str[20];
	float2str(Data,Str);	
	LCD_Write_string(Str,X,Y);
	LCD_write_char(' ');//一般在显示完成之后再写一个空格，确保清掉上次显示遗留的数据
	LCD_write_char(' ');//一般在显示完成之后再写一个空格，确保清掉上次显示遗留的数据
}


/***********浮点数据转字符串函数**************/
void float2str(float data,unsigned char*s)
{
	unsigned int num,lable=1000000000;
	unsigned char ii,tt;
	if(data<0)
	{
		*s++='-';
		data=-data;
	}
	num=(unsigned int)(data*1000);
	for(ii=9;ii>3;ii--)
	{
		if(num/lable)
		{
			break;
		}
		else
		{
		 	lable/=10;
		}
	}
	ii++;
	for(tt=0;tt<=ii;tt++)
	{
		if(ii-tt!=3)
		{
			*s++=num_table[num%(lable*10)/lable];
			lable/=10;
		}
		else
		{
			*s++='.';
		}
	}
	*s=0;
}


void int2str(signed int data,unsigned char*s)
{
	unsigned int lable=1000000000;

	if(data<0)
	{
		*s++='-';
		data=-data;
	}
	for(;;)
	{
		if((data/lable)||(lable==1))
		{break;}
		else
		{lable/=10;}
	}
	while(lable>=1)
	{
		*s++=num_table[data%(lable*10)/lable];
		lable/=10;
	}
	*s=0;
}





